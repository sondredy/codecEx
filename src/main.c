/*
 * Copyright 2025 SiFli Technologies(Nanjing) Co., Ltd
 *
 * SPDX-License-Identifier: Apache-2.0
 */

#include <stdio.h>
#include <string.h>
#include <zephyr/kernel.h>
#include <zephyr/logging/log.h>

#include <lc3.h>

LOG_MODULE_REGISTER(lc3_check);

/* LC3 stream parameters */
#define LC3_DT_US          10000   /* frame duration: 10 ms */
#define LC3_SR_HZ          16000   /* sample rate */
#define LC3_BITRATE_BPS    32000   /* target bitrate (mono) */

/* 10 ms frame at 16 kHz mono = 160 samples (S16 => 320 bytes PCM). */
#define LC3_NUM_SAMPLES    160

/* Input PCM, one frame of S16 mono. The bundled sample is shorter than a
 * frame, so the tail is zero-padded; that is fine for a codec sanity check.
 */
static int16_t pcm_in[LC3_NUM_SAMPLES];

/* Decoded PCM output. */
static int16_t pcm_out[LC3_NUM_SAMPLES];

/* LC3 bitstream buffer. A 10 ms / 32 kbps frame is 40 bytes; 64 is ample. */
static uint8_t lc3_buf[64];

/* Caller-allocated codec contexts (static, no heap). The *_16k_t types cover
 * any frame duration up to a 16 kHz sample rate.
 */
static lc3_encoder_mem_16k_t enc_mem;
static lc3_decoder_mem_16k_t dec_mem;

/* PCM sample (S16 LE), reused from the original codec sample. */
static const uint8_t pcm_sample[] = {
	0x01, 0x00, 0xFE, 0x17, 0x55, 0x2C, 0xEB, 0x39, 0xB1, 0x3E, 0xEC, 0x39, 0x55, 0x2C, 0xFE,
	0x17, 0x01, 0x00, 0x02, 0xE8, 0xAC, 0xD3, 0x15, 0xC6, 0x4F, 0xC1, 0x15, 0xC6, 0xAC, 0xD3,
	0x03, 0xE8, 0x00, 0x00, 0xFD, 0x17, 0x54, 0x2C, 0xEB, 0x39, 0xB1, 0x3E, 0xEC, 0x39, 0x54,
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	0xC6, 0xAB, 0xD3, 0x03, 0xE8,
};

int main(void)
{
	lc3_encoder_t enc;
	lc3_decoder_t dec;
	int nbytes;
	int ret;

	uint64_t time_stamp;
	int64_t delta_time;

	LOG_INF("LC3 software codec check (liblc3 / lc3.h)");
	LOG_INF("running on arch: %s", CONFIG_ARCH);

	/* Load one frame of PCM from the bundled sample (zero-pad the tail). */
	memset(pcm_in, 0, sizeof(pcm_in));
	memcpy(pcm_in, pcm_sample, MIN(sizeof(pcm_sample), sizeof(pcm_in)));

	/* Frame size in bytes for the chosen bitrate. */
	nbytes = lc3_frame_bytes(LC3_DT_US, LC3_BITRATE_BPS);
	if (nbytes < 0 || (size_t)nbytes > sizeof(lc3_buf)) {
		LOG_ERR("bad frame size: %d", nbytes);
		return -EINVAL;
	}
	LOG_INF("frame: %d samples -> %d LC3 bytes", LC3_NUM_SAMPLES, nbytes);

	/* Set up encoder/decoder in caller-provided static memory. */
	enc = lc3_setup_encoder(LC3_DT_US, LC3_SR_HZ, 0 /* no resample */, &enc_mem);
	dec = lc3_setup_decoder(LC3_DT_US, LC3_SR_HZ, 0 /* no resample */, &dec_mem);
	if (enc == NULL || dec == NULL) {
		LOG_ERR("setup failed (enc=%p dec=%p)", (void *)enc, (void *)dec);
		return -EINVAL;
	}

	/* Encode one frame: PCM (S16) -> LC3. */
	time_stamp = k_uptime_get();
	ret = lc3_encode(enc, LC3_PCM_FORMAT_S16, pcm_in, 1 /* stride */, nbytes, lc3_buf);
	if (ret != 0) {
		LOG_ERR("lc3_encode failed (%d)", ret);
		return -EIO;
	}
	delta_time = k_uptime_delta(&time_stamp);
	LOG_INF("encoded %u PCM bytes -> %d LC3 bytes in %dms.", (unsigned)sizeof(pcm_in), nbytes, delta_time);


	/* Decode it back: LC3 -> PCM (S16). Returns 0, or 1 if PLC kicked in. */
	time_stamp = k_uptime_get();
	ret = lc3_decode(dec, lc3_buf, nbytes, LC3_PCM_FORMAT_S16, pcm_out, 1 /* stride */);
	if (ret < 0) {
		LOG_ERR("lc3_decode failed (%d)", ret);
		return -EIO;
	}
	delta_time = k_uptime_delta(&time_stamp);
	LOG_INF("decoded %d LC3 bytes -> %u PCM bytes%s in %dms.", nbytes, (unsigned)sizeof(pcm_out),
		ret == 1 ? " (PLC applied)" : "", delta_time);

	LOG_INF("LC3 roundtrip OK. Codec runs on this (%s) core.", CONFIG_ARCH);
	LOG_INF("Done");
	return 0;
}
